#include "stm32f10x.h"                  // Device header
#include "MyOLED.h"
#include "MyOLED_Render.h"

const uint8_t Font_ASCII_8x16[][8] =
{
{0x00,0x00,0x00,0x00,0x00,0x00,0x00,0x00,},
{0x00,0x00,0x00,0x00,0x00,0x00,0x00,0x00,},/*" ",0*/
{0x00,0x00,0x00,0xFC,0xFC,0x00,0x00,0x00,},
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{0x01,0x00,0x00,0x00,0x01,0x02,0x03,0x01,},/*"~",94*/
};

const uint8_t Icon_64x64[8][64] =
{
{0x00,0x00,0x00,0x00,0x00,0x00,0x00,0x00,0x00,0x00,0x00,0x00,0x00,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0x00,},
{0x00,0x00,0x00,0x00,0x00,0x00,0x00,0x00,0x00,0xC0,0xE0,0xF0,0xF8,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0x00,},
{0x00,0x00,0x00,0x00,0x80,0xE0,0xF8,0xFE,0x7F,0x1F,0x07,0x03,0x00,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0x00,},
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{0x00,0x00,0x00,0x00,0x00,0x00,0x00,0x00,0x00,0x00,0x00,0x00,0x00,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0x00,}
};


/**
 * @brief 将一个字符图像数据覆盖在显存缓存的指定位置上
 * @param Left 字符左上角的横坐标像素位置，0 ~ 127
 * @param Top 字符左上角的纵坐标像素位置，0 ~ 63
 * @param Char 字符
 * @retval 无
 */
void MyOLED_Blit_Char_ASCII_8x16(uint8_t Left, uint8_t Top, char Char)
{
    MyOLED_Blit_GRAM(Font_ASCII_8x16[(Char-' ')*2], Left, Top, 8);
    MyOLED_Blit_GRAM(Font_ASCII_8x16[(Char-' ')*2+1], Left, Top+8, 8);
}

/**
 * @brief 将一个字符串图像数据覆盖在显存缓存的指定位置上
 * @param Left 字符左上角的横坐标像素位置，0 ~ 127
 * @param Top 字符左上角的纵坐标像素位置，0 ~ 63
 * @param String 字符串
 * @retval 无
 */
void MyOLED_Blit_String_ASCII_8x16(uint8_t Left, uint8_t Top, char *String)
{
    uint8_t i;
    for (i = 0; String[i] != '\0'; i++)
    {
        MyOLED_Blit_Char_ASCII_8x16(Left + i * 8, Top, String[i]);
    }
}

/**
 * @brief 将正十进制数形式数字的图像数据覆盖在显存缓存指定区域
 * @param Left 0 ~ 127
 * @param Top 0 ~ 64
 * @param Number 要显示的数字，0 ~ 0xFFFFFFFF
 * @param Length 要显示数字的长度，1 ~ 10
 * @retval 无
 */
void MyOLED_Blit_Num_ASCII_8x16(uint8_t Left, uint8_t Top, uint32_t Number, uint8_t Length)
{
    uint8_t i;
    for (i = Length; i > 0; i--)                            
    {
        MyOLED_Blit_Char_ASCII_8x16(Left + 8 * (i-1), Top, Number % 10 + '0');
        Number /= 10;
    }
}

/**
 * @brief 将带符号十进制数形式数字的图像数据覆盖在显存缓存指定区域
 * @param Left 0 ~ 127
 * @param Top 0 ~ 64
 * @param Number 要显示的数字，-0xFFFFFFF ~ +0xFFFFFFF
 * @param Length 要显示数字的长度，1 ~ 10
 * @retval 无
 */
void MyOLED_Blit_SignedNum_ASCII_8x16(uint8_t Left, uint8_t Top, int32_t Number, uint8_t Length)
{
    if (Number < 0)
    {
        MyOLED_Blit_Char_ASCII_8x16(Left, Top, '-');
        MyOLED_Blit_Num_ASCII_8x16(Left + 8, Top, -Number, Length);
    } else
    {
        MyOLED_Blit_Char_ASCII_8x16(Left, Top, '+');
        MyOLED_Blit_Num_ASCII_8x16(Left + 8, Top, Number, Length);
    }
}

/**
 * @brief 将十六进制数形式数字的图像数据覆盖在显存缓存指定区域
 * @param Left 0 ~ 127
 * @param Top 0 ~ 64
 * @param Number 要显示的数字，0xFFFFFFFF ~ 0xFFFFFFFF
 * @param Length 要显示数字的长度，1 ~ 8，不包括前面的“0x”
 * @retval 无
 */
void MyOLED_Blit_HexNum_ASCII_8x16(uint8_t Left, uint8_t Top, uint32_t Number, uint8_t Length)
{
    uint8_t i, SingleNumber;
    MyOLED_Blit_Char_ASCII_8x16(Left, Top, '0');
    MyOLED_Blit_Char_ASCII_8x16(Left + 8, Top, 'x');
    for (i = Length; i > 0; i--)
    {
        SingleNumber = Number % 16;
        Number /= 16;
        if (SingleNumber < 10)
            MyOLED_Blit_Char_ASCII_8x16(Left + 8 + 8*i, Top, SingleNumber + '0');
        else
            MyOLED_Blit_Char_ASCII_8x16(Left + 8 + 8*i, Top, SingleNumber - 10 + 'A');
    }
}

/**
 * @brief 将二进制数形式数字的图像数据覆盖在显存缓存指定区域
 * @param Left 0 ~ 127
 * @param Top 0 ~ 64
 * @param Number 要显示的数字，0xFFFF ~ 0xFFFF
 * @param Length 要显示数字的长度，1 ~ 14，不包括前面的“0b”
 * @retval 无
 */
void MyOLED_Blit_BinNum_ASCII_8x16(uint8_t Left, uint8_t Top, uint16_t Number, uint8_t Length)
{
    uint8_t i;

    MyOLED_Blit_Char_ASCII_8x16(Left, Top, '0');
    MyOLED_Blit_Char_ASCII_8x16(Left + 8, Top, 'b');
    for (i = Length; i > 0; i--)                            
    {
        MyOLED_Blit_Char_ASCII_8x16(Left + 8 + 8*i, Top, Number % 2 + '0');
        Number /= 2;
    }
}

/**
 * @brief 将小数的图像数据覆盖在显存缓存指定区域
 * @param Left 0 ~ 127
 * @param Top 0 ~ 64
 * @param Number 要显示的小数
 * @param int_Length 整数部分的长度
 * @param float_Length 小数部分的长度
 * @retval 无
 */
void MyOLED_Blit_FloatNum_ASCII_8x16(uint8_t Left, uint8_t Top, float Number, uint8_t int_Length, uint8_t float_Length)
{
    int i, j = 1;
    for (i = 0; i < float_Length; i ++) j *= 10;
    MyOLED_Blit_Num_ASCII_8x16(Left, Top, Number, int_Length);
    MyOLED_Blit_Char_ASCII_8x16(Left + 8 * int_Length, Top, '.');
    MyOLED_Blit_Num_ASCII_8x16(Left + 8 * (int_Length + 1), Top, (uint32_t)(Number * j) % j, float_Length);
}

/**
 * @brief 绘制圆
 * @param centerX 圆心横坐标
 * @param centerY 圆心纵坐标
 * @param radius 半径
 * @param bd 边框粗细
 */
void MyOLED_DrawCircle(uint8_t centerX, uint8_t centerY, uint8_t radius, uint8_t bd)
{
    int x = radius;
    int y = 0;
    int err = 0;

    while (x >= y) {
        for (int i = 0; i < bd; i++) {
            MyOLED_Blit_Point(centerX + x - i, centerY + y, 1);
            MyOLED_Blit_Point(centerX + y - i, centerY + x, 1);
            MyOLED_Blit_Point(centerX - y - i, centerY + x, 1);
            MyOLED_Blit_Point(centerX - x - i, centerY + y, 1);
            MyOLED_Blit_Point(centerX - x - i, centerY - y, 1);
            MyOLED_Blit_Point(centerX - y - i, centerY - x, 1);
            MyOLED_Blit_Point(centerX + y - i, centerY - x, 1);
            MyOLED_Blit_Point(centerX + x - i, centerY - y, 1);
        }

        if (err <= 0) {
            y += 1;
            err += 2 * y + 1;
        }

        if (err > 0) {
            x -= 1;
            err -= 2 * x + 1;
        }
    }
}

/**
 * @brief 在指定位置上渲染fantas图标
 * @param Left 图标左端的横坐标像素位置，0 ~ 64
 * @retval 无
 */
void MyOLED_Blit_Icon_64x64(uint8_t Left)
{
    uint8_t j;
    for (j = 0; j < 8; j++)
    {
        MyOLED_Blit_GRAM(Icon_64x64[j], Left, j*8, 64);
    }
}
